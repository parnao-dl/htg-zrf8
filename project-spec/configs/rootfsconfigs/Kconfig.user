## project-spec/configs/rootfsconfigs/Kconfig.user
```kconfig
menu "user packages " 
config board-tests  
	 bool "board-tests"
	 help
	
config bootscript  
	 bool "bootscript"
	 help
	
config gpio-demo  
	 bool "gpio-demo"
	 help
	
config peekpoke  
	 bool "peekpoke"
	 help
	
config rfdc  
	 bool "rfdc"
	 help
	
config rfdc-intr  
	 bool "rfdc-intr"
	 help
	
config rfdc-read-write  
	 bool "rfdc-read-write"
	 help
	
config rfdc-selftest  
	 bool "rfdc-selftest"
	 help
	
endmenu
```
